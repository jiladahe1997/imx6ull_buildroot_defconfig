## configs/renmingrui_defconfig
```kconfig
BR2_arm=y
BR2_cortex_a7=y
BR2_CCACHE=y
BR2_TOOLCHAIN_EXTERNAL=y
BR2_TOOLCHAIN_EXTERNAL_LINARO_ARM=y
BR2_INIT_SYSTEMD=y
BR2_TARGET_GENERIC_ROOT_PASSWD="renmingrui"
BR2_ROOTFS_OVERLAY="board/renmingrui/rootfs_overlay"
BR2_ROOTFS_POST_BUILD_SCRIPT="board/renmingrui/post-image.sh"
BR2_PACKAGE_ALSA_UTILS=y
BR2_PACKAGE_ALSA_UTILS_AMIXER=y
BR2_PACKAGE_ALSA_UTILS_SPEAKER_TEST=y
BR2_PACKAGE_MPG123=y
BR2_PACKAGE_PULSEAUDIO=y
BR2_PACKAGE_DEJAVU=y
BR2_PACKAGE_QT5=y
BR2_PACKAGE_QT5BASE_EXAMPLES=y
BR2_PACKAGE_QT5BASE_WIDGETS=y
BR2_PACKAGE_QT5BASE_LINUXFB=y
BR2_PACKAGE_QT5BASE_XCB=y
BR2_PACKAGE_QT5BASE_FONTCONFIG=y
BR2_PACKAGE_QT5BASE_JPEG=y
BR2_PACKAGE_QT5BASE_PNG=y
BR2_PACKAGE_QT5MULTIMEDIA=y
BR2_PACKAGE_XORG7=y
BR2_PACKAGE_RNG_TOOLS=y
BR2_PACKAGE_LIBCURL=y
BR2_PACKAGE_HAVEGED=y
BR2_PACKAGE_AUTOSSH=y
BR2_PACKAGE_CONNMAN=y
BR2_PACKAGE_OPENSSH=y
BR2_PACKAGE_SSHPASS=y
```

## renmingrui_defconfig
```kconfig
BR2_arm=y
BR2_cortex_a7=y
BR2_CCACHE=y
BR2_TOOLCHAIN_EXTERNAL=y
BR2_TOOLCHAIN_EXTERNAL_LINARO_ARM=y
BR2_INIT_SYSTEMD=y
BR2_TARGET_GENERIC_ROOT_PASSWD="renmingrui"
BR2_ROOTFS_OVERLAY="board/renmingrui/rootfs_overlay"
BR2_ROOTFS_POST_BUILD_SCRIPT="board/renmingrui/post-image.sh"
BR2_PACKAGE_RNG_TOOLS=y
BR2_PACKAGE_HAVEGED=y
BR2_PACKAGE_AUTOSSH=y
BR2_PACKAGE_CONNMAN=y
BR2_PACKAGE_OPENSSH=y
BR2_PACKAGE_SSHPASS=y
```
